## config/west.yml
```yaml
manifest:
  defaults:
    revision: v0.3
  remotes:
    - name: zmkfirmware
      url-base: https://github.com/zmkfirmware
    - name: t0bybr
      url-base: https://github.com/t0bybr
    - name: genteure
      url-base: https://github.com/Genteure
    # Additional modules containing boards/shields/custom code can be listed here as well
    # See https://docs.zephyrproject.org/3.2.0/develop/west/manifest.html#projects
  projects:
    - name: zmk
      remote: zmkfirmware
      import: app/west.yml
    - name: zmk-driver-pim447
      remote: genteure
      revision: 3d09ddb19dbf8482d0bb67bb8f6d145c4b997685
  self:
    path: config
```
